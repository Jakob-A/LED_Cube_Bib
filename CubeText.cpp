#include "CubeText.h"
#include "DrawFunctions.h"
#include <string.h>
#include <Time.h>
#include <Wire.h>
#include "Arduino.h"

#define MINUTES 1
#define SECONDS 2
#define HOURS 3

unsigned char Uhr[10][8] = {
        {0x00, 0x00, 0x07, 0x05, 0x05, 0x05, 0x07, 0x00},//0
        {0x00, 0x00, 0x04, 0x04, 0x04, 0x04, 0x04, 0x00},//1
        {0x00 ,0x00, 0x07, 0x04, 0x07, 0x01, 0x07, 0x00},//2
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        {0x00, 0x00, 0x07, 0x05, 0x07, 0x04, 0x07, 0x00}//9
};
unsigned char font_data[128][8] = {
        { 0x00,  0x00,  0x00,  0x00,  0x00,  0x00,  0x00,  0x00 },    // 0 :
        { 0x00,  0x3E,  0x41,  0x55,  0x41,  0x55,  0x49,  0x3E },    // 1 : 
        { 0x00,  0x3E,  0x7F,  0x6B,  0x7F,  0x6B,  0x77,  0x3E },    // 2 : 
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        { 0x00,  0x08,  0x1C,  0x36,  0x63,  0x41,  0x41,  0x7F }    // 127 : 
};


void CText::effect_textBle(int delayt, char* input) {
  int d = (int) strlen(input) + 1 ;
  char Text[d];
  memcpy(Text, input, d);

  Draw::fill(0x00);

  for (int ltr = 0; ltr < d; ltr++) { // For each letter in string array
    for (int dist = 0; dist < 8; dist++) { //bring letter forward
      Draw::fill(0x00);//blank last row
      int rev = 0;
      for (int rw = 7; rw >= 0; rw--) {//copy rows
        Draw::cube[rev][dist] = CText::bitswap(font_data[Text[ltr]][rw]);
        rev++;
      }
      Draw::delay_ms(delayt);
    }
  }
}

void CText::effect_textUHR(int minutes, int hours, int seconds) {

    Draw::fill(0x00);

    printOutside(minutes, MINUTES);

    printOutside(hours, HOURS);

    printOutside(seconds, SECONDS);

}

int CText::printOutside(int time, int side){
    
    int Zehner = 0;
    int Einer = 0;
    CText::Vereinzeln(time, &Zehner, &Einer);

    int row = 0;
    for (int rw = 7; rw >= 0; rw--) {//copy rows
        unsigned char Entscheider = CText::bitswap(Uhr[Zehner][rw])+(bitswap(Uhr[Einer][rw])>>4u) ;
        
        for (int c = 7; c>=0; c--){
            unsigned char B = 0x01u << (unsigned int)c;
            
            switch (side)
            {
            case MINUTES:
                if (Entscheider & B){
                    Draw::setvoxel(c,0,row);
                }
                else {
                    Draw::clrvoxel(c,0,row);
                }
                break;
            
            case SECONDS:
                if (Entscheider & B){
                    Draw::setvoxel(c,row,7);
                }
                else {
                    Draw::clrvoxel(c,row,7);
                }
                break;
            
            case HOURS:
                if (Entscheider & B){
                    Draw::setvoxel(7,c,row);
                }
                else {
                    Draw::clrvoxel(7,c,row);
                }
            
            default:
                return -1;
            }
        }

        row++;
    } 

    return 0;
}

void CText::Vereinzeln(int k, int *Zehner, int *Einer){
  *Zehner= k/10;
  *Einer=k-10 * (*Zehner);
}

unsigned char CText::bitswap (unsigned char x)//Reverses a byte (so letters aren't backwards);
{ byte result;

  asm("mov __tmp_reg__, %[in] \n\t"
      "lsl __tmp_reg__  \n\t"   /* shift out high bit to carry */
      "ror %[out] \n\t"  /* rotate carry __tmp_reg__to low bit (eventually) */
      "lsl __tmp_reg__  \n\t"   /* 2 */
      "ror %[out] \n\t"
      "lsl __tmp_reg__  \n\t"   /* 3 */
      "ror %[out] \n\t"
      "lsl __tmp_reg__  \n\t"   /* 4 */
      "ror %[out] \n\t"

      "lsl __tmp_reg__  \n\t"   /* 5 */
      "ror %[out] \n\t"
      "lsl __tmp_reg__  \n\t"   /* 6 */
      "ror %[out] \n\t"
      "lsl __tmp_reg__  \n\t"   /* 7 */
      "ror %[out] \n\t"
      "lsl __tmp_reg__  \n\t"   /* 8 */
      "ror %[out] \n\t"
      : [out] "=r" (result) : [in] "r" (x));
  return (result);
}
